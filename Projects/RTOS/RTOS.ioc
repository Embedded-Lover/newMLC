# file: RTOS.ioc
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FREERTOS.Tasks01=defaultTask,0,128,StartDefaultTask,Default,NULL,Dynamic,NULL,NULL
Mcu.Family=STM32H7
Mcu.Name=STM32H7B0VBTx
Mcu.Package=LQFP100
NVIC.PriorityGroup=NVIC_PRIORITYGROUP_4
NVIC.TIM1_UP_IRQn=true\:15\:0\:false\:false\:true\:false\:false\:true\:true
NVIC.TimeBase=TIM1_UP_IRQn
NVIC.TimeBaseIP=TIM1
PA13.Mode=Serial_Wire
PA13.Signal=DEBUG_JTMS-SWDIO
PA14.Mode=Serial_Wire
PA14.Signal=DEBUG_JTCK-SWCLK
PH0-OSC_IN.Mode=HSE-External-Oscillator
PH0-OSC_IN.Signal=RCC_OSC_IN
PH1-OSC_OUT.Mode=HSE-External-Oscillator
PH1-OSC_OUT.Signal=RCC_OSC_OUT
ProjectManager.HeapSize=0x200
ProjectManager.StackSize=0x400
ProjectManager.TargetToolchain=STM32CubeIDE
RCC.ADCFreq_Value=50390625
RCC.APB1Freq_Value=35000000
RCC.APB2Freq_Value=70000000
RCC.APB3Freq_Value=70000000
RCC.APB4Freq_Value=140000000
RCC.CDPPRE=RCC_APB3_DIV4
RCC.CDPPRE1=RCC_APB1_DIV8
RCC.CDPPRE2=RCC_APB2_DIV4
RCC.CortexFreq_Value=280000000
RCC.DIVM1=5
RCC.DIVN1=112
RCC.HCLKFreq_Value=280000000
RCC.HSE_VALUE=25000000
RCC.PLLSourceVirtual=RCC_PLLSOURCE_HSE
RCC.SRDPPRE=RCC_APB4_DIV2
RCC.SYSCLKFreq_VALUE=280000000
RCC.SYSCLKSource=RCC_SYSCLKSOURCE_PLLCLK
RCC.USBFreq_Value=280000000
VP_FREERTOS_VS_CMSIS_V1.Mode=CMSIS_V1
VP_SYS_VS_tim1.Mode=TIM1
board=custom

// file: Core/Src/main.c
/* USER CODE BEGIN Header */
/**
 ******************************************************************************
 * @file           : main.c
 * @brief          : Main program body
 ******************************************************************************
 * @attention
 *
 * Copyright (c) 2024 STMicroelectronics.
 * All rights reserved.
 *
 * This software is licensed under terms that can be found in the LICENSE file
 * in the root directory of this software component.
 * If no LICENSE file comes with this software, it is provided AS-IS.
 *
 ******************************************************************************
 */
/* USER CODE END Header */
#include "main.h"
#include "cmsis_os.h"
#include "gpio.h"

/* USER CODE BEGIN Includes */
#include <stdio.h>
#include <string.h>
#include "FreeRTOS.h"
#include "task.h"
#include "queue.h"
/* USER CODE END Includes */

/* USER CODE BEGIN PTD */
uint8_t x;
uint64_t x0;
uint64_t x1;
uint64_t x2;
uint64_t send;
uint64_t receive;
char global[100];
/* USER CODE END PTD */

/* USER CODE BEGIN PD */
TaskHandle_t xTask1Handle = NULL;
TaskHandle_t xTask2Handle = NULL;
QueueHandle_t xQueue = NULL;
SemaphoreHandle_t xMutex = NULL;
/* USER CODE END PD */

void SystemClock_Config(void);
void MX_FREERTOS_Init(void);

/* USER CODE BEGIN 0 */
void vTask1( void * pvParameters );
void vTask2( void * pvParameters );
void vTask3( void * pvParameters );
void vTask4( void * pvParameters );
void vSenderTask( void * pvParameters );
void vReceiverTask( void * pvParameters );

/* USER CODE END 0 */

int main(void)
{

  /* MCU Configuration--------------------------------------------------------*/

  /* Reset of all peripherals, Initializes the Flash interface and the Systick. */
  HAL_Init();

  /* Configure the system clock */
  SystemClock_Config();

  /* Initialize all configured peripherals */
  MX_GPIO_Init();
  /* USER CODE BEGIN 2 */
  xTaskCreate(vTask1, "vTask1", 100, NULL, 1, &xTask1Handle);
  xTaskCreate(vTask2, "vTask2", 100, NULL, 2, &xTask2Handle);
  xTaskCreate(vTask3, "vTask3", 1000, NULL, 3, NULL);
  xTaskCreate(vTask4, "vTask4", 1000, NULL, 4, NULL);
  xTaskCreate(vSenderTask, "vSenderTask1", 100, (void*)100, 3, NULL);
  xTaskCreate(vSenderTask, "vSenderTask1", 100, (void*)200, 3, NULL);
  xTaskCreate(vReceiverTask, "vReceiverTask", 100, NULL, 2, NULL);
  //
  xMutex = xSemaphoreCreateMutex();
  if(xMutex != NULL);
  //
  xQueue = xQueueCreate(100, sizeof(uint32_t));
  if(xQueue != NULL);
  //

  vTaskStartScheduler();

  /* USER CODE END 2 */

  /* Call init function for freertos objects (in freertos.c) */
  //MX_FREERTOS_Init();

  /* Start scheduler */
  //osKernelStart();

  /* We should never get here as control is now taken by the scheduler */
  /* Infinite loop */
	while (1)
	{
		//non thread-safe function
		//mutex --> resources (globals- static) / peripherals
		//semophore --> syncronization
	}
}

void SystemClock_Config(void)
{
  RCC_OscInitTypeDef RCC_OscInitStruct = {0};
  RCC_ClkInitTypeDef RCC_ClkInitStruct = {0};

  /*AXI clock gating */
  RCC->CKGAENR = 0xFFFFFFFF;

  /** Supply configuration update enable
  */
  HAL_PWREx_ConfigSupply(PWR_LDO_SUPPLY);

  /** Configure the main internal regulator output voltage
  */
  __HAL_PWR_VOLTAGESCALING_CONFIG(PWR_REGULATOR_VOLTAGE_SCALE0);

  while(!__HAL_PWR_GET_FLAG(PWR_FLAG_VOSRDY)) {}

  /** Initializes the RCC Oscillators according to the specified parameters
  * in the RCC_OscInitTypeDef structure.
  */
  RCC_OscInitStruct.OscillatorType = RCC_OSCILLATORTYPE_HSE;
  RCC_OscInitStruct.HSEState = RCC_HSE_ON;
  RCC_OscInitStruct.PLL.PLLState = RCC_PLL_ON;
  RCC_OscInitStruct.PLL.PLLSource = RCC_PLLSOURCE_HSE;
  RCC_OscInitStruct.PLL.PLLM = 5;
  RCC_OscInitStruct.PLL.PLLN = 112;
  RCC_OscInitStruct.PLL.PLLP = 2;
  RCC_OscInitStruct.PLL.PLLQ = 2;
  RCC_OscInitStruct.PLL.PLLR = 2;
  RCC_OscInitStruct.PLL.PLLRGE = RCC_PLL1VCIRANGE_2;
  RCC_OscInitStruct.PLL.PLLVCOSEL = RCC_PLL1VCOWIDE;
  RCC_OscInitStruct.PLL.PLLFRACN = 0;
  if (HAL_RCC_OscConfig(&RCC_OscInitStruct) != HAL_OK)
  {
    Error_Handler();
  }

  /** Initializes the CPU, AHB and APB buses clocks
  */
  RCC_ClkInitStruct.ClockType = RCC_CLOCKTYPE_HCLK|RCC_CLOCKTYPE_SYSCLK
                              |RCC_CLOCKTYPE_PCLK1|RCC_CLOCKTYPE_PCLK2
                              |RCC_CLOCKTYPE_D3PCLK1|RCC_CLOCKTYPE_D1PCLK1;
  RCC_ClkInitStruct.SYSCLKSource = RCC_SYSCLKSOURCE_PLLCLK;
  RCC_ClkInitStruct.SYSCLKDivider = RCC_SYSCLK_DIV1;
  RCC_ClkInitStruct.AHBCLKDivider = RCC_HCLK_DIV1;
  RCC_ClkInitStruct.APB3CLKDivider = RCC_APB3_DIV4;
  RCC_ClkInitStruct.APB1CLKDivider = RCC_APB1_DIV8;
  RCC_ClkInitStruct.APB2CLKDivider = RCC_APB2_DIV4;
  RCC_ClkInitStruct.APB4CLKDivider = RCC_APB4_DIV2;

  if (HAL_RCC_ClockConfig(&RCC_ClkInitStruct, FLASH_LATENCY_6) != HAL_OK)
  {
    Error_Handler();
  }
}

/* USER CODE BEGIN 4 */
void vApplicationIdleHook( void )
{
 /* This hook function does nothing but increment a counter. */
  x0++;
}

void vTask1( void * pvParameters )
{

	while(1)
	{
         x1++;
         vTaskDelay(pdMS_TO_TICKS(1000));
	}
}

void vTask2( void * pvParameters )
{

	TickType_t xLastWakeTime = xTaskGetTickCount();
	while(1)
	{
        x2++;
        vTaskDelayUntil(&xLastWakeTime, pdMS_TO_TICKS(1000));
	}
}

void vTask3( void * pvParameters )
{
	char c[] = "llllllllllllllllllllllllllllllllllllllllllllllllllllllllllllllllllllllllllllllllllllllllllllllllllll";
	while(1)
	{
		//xSemaphoreTake( xMutex, pdMS_TO_TICKS(100));

		{
			memcpy(&global, c, 100);
		}

		//xSemaphoreGive( xMutex);
		vTaskDelay(pdMS_TO_TICKS(1000));
	}
}

void vTask4( void * pvParameters )
{
    char c [] = "hhhhhhhhhhhhhhhhhhhhhhhhhhhhhhhhhhhhhhhhhhhhhhhhhhhhhhhhhhhhhhhhhhhhhhhhhhhhhhhhhhhhhhhhhhhhhhhhhhhh";
	while(1)
	{
		//xSemaphoreTake( xMutex, pdMS_TO_TICKS(100));

		{
			memcpy(&global, c, 100);
		}

		//xSemaphoreGive( xMutex);
		vTaskDelay(pdMS_TO_TICKS(900));
	}
}

void vSenderTask( void * pvParameters )
{
    uint32_t data = (uint32_t)pvParameters;
    BaseType_t xStatus;

	while(1)
	{
		xStatus = xQueueSendToBack( xQueue, &data, pdMS_TO_TICKS(100));
 		if( xStatus == pdPASS )
		{
			send = data;
		}
	}
}

void vReceiverTask( void * pvParameters )
{
    uint32_t data;
    BaseType_t xStatus;

	while(1)
	{
		if( uxQueueMessagesWaiting( xQueue ) != 0 )
		{

		}

		xStatus = xQueueReceive(xQueue, &data, 0);
		if( xStatus == pdPASS )
		{
			receive = data;
		}
	}
}

/* USER CODE END 4 */

void HAL_TIM_PeriodElapsedCallback(TIM_HandleTypeDef *htim)
{
  if (htim->Instance == TIM1) {
    HAL_IncTick();
  }
}

void Error_Handler(void)
{
	__disable_irq();
	while (1)
	{
	}
}
